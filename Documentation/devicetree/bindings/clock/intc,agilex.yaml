## Documentation/devicetree/bindings/clock/intc,agilex.yaml
```yaml
# SPDX-License-Identifier: GPL-2.0
%YAML 1.2
---
$id: http://devicetree.org/schemas/clock/intc,agilex.yaml#
$schema: http://devicetree.org/meta-schemas/core.yaml#

title: Intel SoCFPGA Agilex platform clock controller binding

maintainers:
  - Dinh Nguyen <dinguyen@kernel.org>

description: |
  The Intel Agilex Clock controller is an integrated clock controller, which
  generates and supplies to all modules.

  This binding uses the common clock binding[1].
  [1] Documentation/devicetree/bindings/clock/clock-bindings.txt

properties:
  compatible:
    oneOf:
      - items:
          - enum:
              - intel,agilex-clkmgr

  '#clock-cells':
    const: 1

required:
  - compatible
  - reg
  - '#clock-cells'

examples:
  # Clock controller node
  - |
	clkmgr: clock-controller@ffd10000 {
		compatible = "intel,agilex-clkmgr";
		reg = <0xffd10000 0x1000>;
		#clock-cells = <1>;
	};

  # External clocks
  - |
    clocks {
       cb_intosc_hs_div2_clk: cb-intosc-hs-div2-clk {
		#clock-cells = <0>;
		compatible = "fixed-clock";
		};

	cb_intosc_ls_clk: cb-intosc-ls-clk {
		#clock-cells = <0>;
			compatible = "fixed-clock";
		};

	f2s_free_clk: f2s-free-clk {
		#clock-cells = <0>;
		compatible = "fixed-clock";
		};

	osc1: osc1 {
		#clock-cells = <0>;
		compatible = "fixed-clock";
	};
    };

  # The clock consumer shall specify the desired clock-output of the clock
  # controller as below by specifying output-id in its "clk" phandle cell.
  - |
    i2c0: i2c@ffc02800 {
	#address-cells = <1>;
	#size-cells = <0>;
	compatible = "snps,designware-i2c";
	reg = <0xffc02800 0x100>;
	interrupts = <0 103 4>;
	resets = <&rst I2C0_RESET>;
	clocks = <&clkmgr AGILEX_L4_SP_CLK>;
	};
...
```

## Documentation/devicetree/bindings/misc/intel,agilex5-soc-fcs-config.yaml
```yaml
# SPDX-License-Identifier: (GPL-2.0-only OR BSD-2-Clause)
%YAML 1.2
---
$id: http://devicetree.org/schemas/misc/intel,agilex5-soc-fcs-config.yaml#
$schema: http://devicetree.org/meta-schemas/core.yaml#

title: Altera SoC FPGA Crypto Service (FCS)

maintainers:
  - Genevieve Chan <genevieve.chan@altera.com>
  - Hang Suan Wang <hang.suan.wang@altera.com>

description: |
  The FPGA Crypto Service (FCS) is the umbrella for the SDM's runtime
  crypto-service mailbox commands (random number generation, AES
  encrypt/decrypt, HMAC/SHA, key management, attestation, and more).
  The HPS does not access the SDM directly; requests are channelled
  through EL3 (Arm Trusted Firmware) using SIP SMC calls and surfaced to
  Linux by the stratix10-svc service layer. It represents the FCS
  sub-service of the SDM and must be a child of the service layer ("svc")
  node, mirroring the other SDM sub-service nodes such as the FPGA manager
  and RSU. The compatible string selects the SoC generation, because the
  FCS   mailbox command set and buffer addressing (for example service-SMMU
  remapping) differ between SoCFPGA families.

properties:
  compatible:
    enum:
      - intel,agilex5-soc-fcs-config

additionalProperties: false

required:
  - compatible

examples:
  - |
    fcs_config: fcs-config {
      compatible = "intel,agilex5-soc-fcs-config";
    };
```

## Documentation/devicetree/bindings/net/altr,hssiss.yaml
```yaml
# SPDX-License-Identifier: (GPL-2.0-only OR BSD-2-Clause)
%YAML 1.2
---
$id: http://devicetree.org/schemas/net/altera,hssiss.yaml#
$schema: http://devicetree.org/meta-schemas/core.yaml#

title: Altera HSSI subsystem for ethernet

maintainers:
  - Subhransu S. Prusty <subhransu.sekhar.prusty@altera.com>
  - Narayan, Preetam <preetam.narayan@altera.com>

description: |
  Altera HSSI SS(subsystem) IP provides connectivity to core ethernet IPs (soft IP
  and hard IP). HSSI subsystem runs a firmware enabling netdev users standardized
  access to core ethernet subsystem. HSSI SS manages the configuration of
  ethernet IPs, while facilitating the data transfer between DMA and core
  through AXI interface.

properties:
  compatible:
    const: altr,hssiss-1.0

  reg:
    description: Address and length of configuration space
    minItems: 1
    maxItems: 1

  reg-names:
    items:
      - const: sscsr

  reset-mode:
    description: Interface medium to reset the HSSI SS and ethernet core
    items:
      enum: [ "reg", "gpio" ]

required:
  - compatible
  - reg
  - reg-names
  - reset-mode

additionalProperties: false

examples:
  - |
    hssiss_0_hssiss: hssiss_0_hssiss {
      compatible = "altr,hssiss-1.0";
      reg-names = "sscsr";
      reg = <0x80000000 0x04000000>;
      reset-mode ="reg";
    };
```

## Documentation/devicetree/bindings/reset/intel,agilex5-rst-mgr.yaml
```yaml
# SPDX-License-Identifier: (GPL-2.0-only OR BSD-2-Clause)
%YAML 1.2
---
$id: http://devicetree.org/schemas/reset/intel,agilex5-rst-mgr.yaml#
$schema: http://devicetree.org/meta-schemas/core.yaml#

title: Intel SOCFPGA Reset Manager

maintainers:
  - Niravkumar L Rabara <niravkumar.l.rabara@intel.com>

properties:
  compatible:
    oneOf:
      - description: Agilex5 ARM64 SoCFPGA
        const: intel,agilex5-rst-mgr

  reg:
    maxItems: 1

  '#reset-cells':
    const: 1

required:
  - compatible
  - reg
  - '#reset-cells'

additionalProperties: false

examples:
  - |
    rstmgr@10d11000 {
        compatible = "intel,agilex5-rst-mgr";
        reg = <0x10d11000 0x1000>;
        #reset-cells = <1>;
    };
```

## Documentation/devicetree/bindings/spi/cdns,qspi-nor.yaml
```yaml
# SPDX-License-Identifier: (GPL-2.0 OR BSD-2-Clause)
%YAML 1.2
---
$id: "http://devicetree.org/schemas/spi/cdns,qspi-nor.yaml#"
$schema: "http://devicetree.org/meta-schemas/core.yaml#"

title: Cadence QSPI Flash Controller support

maintainers:
  - Ramuthevar Vadivel Murugan <vadivel.muruganx.ramuthevar@linux.intel.com>

allOf:
  - $ref: "spi-controller.yaml#"

description: |
  Binding Documentation for Cadence QSPI controller,This controller is
  present in the Intel LGM, Altera SoCFPGA and TI SoCs and this driver
  has been tested On Intel's LGM SoC.

  - compatible : should be one of the following:
        Generic default - "cdns,qspi-nor".
        For TI 66AK2G SoC - "ti,k2g-qspi", "cdns,qspi-nor".
        For TI AM654 SoC  - "ti,am654-ospi", "cdns,qspi-nor".
        For Intel LGM SoC - "intel,lgm-qspi", "cdns,qspi-nor".

properties:
  compatible:
    oneOf:
      - items:
        - enum:
           - ti,k2g-qspi
        - const: cdns,qspi-nor

      - items:
        - enum:
           - ti,am654-ospi
        - const: cdns,qspi-nor

      - items:
        - enum:
           - intel,lgm-qspi
        - const: cdns,qspi-nor

      - items:
        - const: cdns,qspi-nor

  reg:
    maxItems: 2

  interrupts:
    maxItems: 1

  clocks:
    maxItems: 1

  cdns,fifo-depth:
    $ref: /schemas/types.yaml#/definitions/uint32
    description:
      Size of the data FIFO in words.

  cdns,fifo-width:
    $ref: /schemas/types.yaml#/definitions/uint32
    description:
      Bus width of the data FIFO in bytes.

  cdns,trigger-address:
    $ref: /schemas/types.yaml#/definitions/uint32
    description:
      32-bit indirect AHB trigger address.

  cdns,rclk-en:
    $ref: /schemas/types.yaml#/definitions/uint32
    description: |
      Flag to indicate that QSPI return clock is used to latch the read data
      rather than the QSPI clock. Make sure that QSPI return clock is populated
      on the board before using this property.

# subnode's properties
patternProperties:
  "^.*@[0-9a-fA-F]+$":
    type: object
    description:
      flash device uses the subnodes below defined properties.

  cdns,read-delay:
    $ref: /schemas/types.yaml#/definitions/uint32
    description:
      Delay for read capture logic, in clock cycles.

  cdns,tshsl-ns:
    $ref: /schemas/types.yaml#/definitions/uint32
    description: |
      Delay in nanoseconds for the length that the master mode chip select
      outputs are de-asserted between transactions.

  cdns,tsd2d-ns:
    $ref: /schemas/types.yaml#/definitions/uint32
    description: |
      Delay in nanoseconds between one chip select being de-activated
      and the activation of another.

  cdns,tchsh-ns:
    $ref: /schemas/types.yaml#/definitions/uint32
    description: |
      Delay in nanoseconds between last bit of current transaction and
      deasserting the device chip select (qspi_n_ss_out).

  cdns,tslch-ns:
    $ref: /schemas/types.yaml#/definitions/uint32
    description: |
      Delay in nanoseconds between setting qspi_n_ss_out low and
      first bit transfer.

required:
  - compatible
  - reg
  - interrupts
  - clocks
  - cdns,fifo-depth
  - cdns,fifo-width
  - cdns,trigger-address

examples:
  - |
    qspi: spi@ff705000 {
          compatible = "cdns,qspi-nor";
          #address-cells = <1>;
          #size-cells = <0>;
          reg = <0xff705000 0x1000>,
                <0xffa00000 0x1000>;
          interrupts = <0 151 4>;
          clocks = <&qspi_clk>;
          cdns,fifo-depth = <128>;
          cdns,fifo-width = <4>;
          cdns,trigger-address = <0x00000000>;

          flash0: n25q00@0 {
              compatible = "jedec,spi-nor";
              reg = <0x0>;
              cdns,read-delay = <4>;
              cdns,tshsl-ns = <50>;
              cdns,tsd2d-ns = <50>;
              cdns,tchsh-ns = <4>;
              cdns,tslch-ns = <4>;
          };
    };
```
